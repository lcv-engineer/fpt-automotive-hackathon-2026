VERSION ""

NS_ :

BS_:

BU_: VHAL EngineECU HVACController DoorECU

BO_ 256 EngineData: 8 EngineECU
 SG_ VehicleSpeed : 0|16@1+ (0.01,0) [0|250] "km/h" VHAL
 SG_ EngineRPM : 16|16@1+ (1,0) [0|8000] "rpm" VHAL

BO_ 512 HVACStatus: 8 HVACController
 SG_ TargetTemperature : 0|8@1+ (0.5,0) [16|30] "degC" VHAL
 SG_ FanSpeed : 8|8@1+ (1,0) [1|5] "" VHAL

BO_ 768 DoorStatus: 8 DoorECU
 SG_ DoorLockStatus : 0|2@1+ (1,0) [0|1] "" VHAL
 SG_ DriverSeatBelt : 2|2@1+ (1,0) [0|1] "" VHAL
